## deploy/yocto/meta-ohboyscan/conf/layer.conf
```bitbake
BBPATH .= ":${LAYERDIR}"
BBFILES += "${LAYERDIR}/recipes-*/*/*.bb ${LAYERDIR}/recipes-*/*/*.bbappend"
BBFILE_COLLECTIONS += "ohboyscan"
BBFILE_PATTERN_ohboyscan = "^${LAYERDIR}/"
BBFILE_PRIORITY_ohboyscan = "10"
LAYERDEPENDS_ohboyscan = "core"
LAYERSERIES_COMPAT_ohboyscan = "kirkstone scarthgap styhead walnascar"
```
